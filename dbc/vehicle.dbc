BO_ 256 VehicleSpeed: 8 ECU
 SG_ speed : 0|16@1+ (1,0) [0|250] "km/h" ECU
